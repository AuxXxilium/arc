## external/Config.in
```kconfig
source "$BR2_EXTERNAL_ARC_PATH/r8168/Config.in"
source "$BR2_EXTERNAL_ARC_PATH/r8125/Config.in"
```

## external/r8125/Config.in
```kconfig
comment "r8125 needs a Linux kernel to be built"
	depends on !BR2_LINUX_KERNEL

config BR2_PACKAGE_R8125
	bool "r8125"
	depends on BR2_LINUX_KERNEL
	help
	  Linux Driver for the Realtek r8125 driver, which supports 2.5 GbE.

	  https://github.com/AuxXxilium/r8125
```

## external/r8168/Config.in
```kconfig
comment "r8168 needs a Linux kernel to be built"
	depends on !BR2_LINUX_KERNEL

config BR2_PACKAGE_R8168
	bool "r8168"
	depends on BR2_LINUX_KERNEL
	help
	  A kernel module for Realtek 8168 network cards

	  https://github.com/mtorromeo/r8168

	  Kernel patches courtesy of:
	  Jan Alexander Steffens (heftig)" <heftig@archlinux.org
```
